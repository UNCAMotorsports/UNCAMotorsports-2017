.ifndef INCLUDED_CYFITTERGNU_INC
.set INCLUDED_CYFITTERGNU_INC, 1
.include "cydevicegnu.inc"
.include "cydevicegnu_trm.inc"

/* CAN_CanIP */
.set CAN_CanIP__CSR_BUF_SR, CYREG_CAN0_CSR_BUF_SR
.set CAN_CanIP__CSR_CFG, CYREG_CAN0_CSR_CFG
.set CAN_CanIP__CSR_CMD, CYREG_CAN0_CSR_CMD
.set CAN_CanIP__CSR_ERR_SR, CYREG_CAN0_CSR_ERR_SR
.set CAN_CanIP__CSR_INT_EN, CYREG_CAN0_CSR_INT_EN
.set CAN_CanIP__CSR_INT_SR, CYREG_CAN0_CSR_INT_SR
.set CAN_CanIP__PM_ACT_CFG, CYREG_PM_ACT_CFG6
.set CAN_CanIP__PM_ACT_MSK, 0x01
.set CAN_CanIP__PM_STBY_CFG, CYREG_PM_STBY_CFG6
.set CAN_CanIP__PM_STBY_MSK, 0x01
.set CAN_CanIP__RX0_ACR, CYREG_CAN0_RX0_ACR
.set CAN_CanIP__RX0_ACRD, CYREG_CAN0_RX0_ACRD
.set CAN_CanIP__RX0_AMR, CYREG_CAN0_RX0_AMR
.set CAN_CanIP__RX0_AMRD, CYREG_CAN0_RX0_AMRD
.set CAN_CanIP__RX0_CMD, CYREG_CAN0_RX0_CMD
.set CAN_CanIP__RX0_DH, CYREG_CAN0_RX0_DH
.set CAN_CanIP__RX0_DL, CYREG_CAN0_RX0_DL
.set CAN_CanIP__RX0_ID, CYREG_CAN0_RX0_ID
.set CAN_CanIP__RX1_ACR, CYREG_CAN0_RX1_ACR
.set CAN_CanIP__RX1_ACRD, CYREG_CAN0_RX1_ACRD
.set CAN_CanIP__RX1_AMR, CYREG_CAN0_RX1_AMR
.set CAN_CanIP__RX1_AMRD, CYREG_CAN0_RX1_AMRD
.set CAN_CanIP__RX1_CMD, CYREG_CAN0_RX1_CMD
.set CAN_CanIP__RX1_DH, CYREG_CAN0_RX1_DH
.set CAN_CanIP__RX1_DL, CYREG_CAN0_RX1_DL
.set CAN_CanIP__RX1_ID, CYREG_CAN0_RX1_ID
.set CAN_CanIP__RX10_ACR, CYREG_CAN0_RX10_ACR
.set CAN_CanIP__RX10_ACRD, CYREG_CAN0_RX10_ACRD
.set CAN_CanIP__RX10_AMR, CYREG_CAN0_RX10_AMR
.set CAN_CanIP__RX10_AMRD, CYREG_CAN0_RX10_AMRD
.set CAN_CanIP__RX10_CMD, CYREG_CAN0_RX10_CMD
.set CAN_CanIP__RX10_DH, CYREG_CAN0_RX10_DH
.set CAN_CanIP__RX10_DL, CYREG_CAN0_RX10_DL
.set CAN_CanIP__RX10_ID, CYREG_CAN0_RX10_ID
.set CAN_CanIP__RX11_ACR, CYREG_CAN0_RX11_ACR
.set CAN_CanIP__RX11_ACRD, CYREG_CAN0_RX11_ACRD
.set CAN_CanIP__RX11_AMR, CYREG_CAN0_RX11_AMR
.set CAN_CanIP__RX11_AMRD, CYREG_CAN0_RX11_AMRD
.set CAN_CanIP__RX11_CMD, CYREG_CAN0_RX11_CMD
.set CAN_CanIP__RX11_DH, CYREG_CAN0_RX11_DH
.set CAN_CanIP__RX11_DL, CYREG_CAN0_RX11_DL
.set CAN_CanIP__RX11_ID, CYREG_CAN0_RX11_ID
.set CAN_CanIP__RX12_ACR, CYREG_CAN0_RX12_ACR
.set CAN_CanIP__RX12_ACRD, CYREG_CAN0_RX12_ACRD
.set CAN_CanIP__RX12_AMR, CYREG_CAN0_RX12_AMR
.set CAN_CanIP__RX12_AMRD, CYREG_CAN0_RX12_AMRD
.set CAN_CanIP__RX12_CMD, CYREG_CAN0_RX12_CMD
.set CAN_CanIP__RX12_DH, CYREG_CAN0_RX12_DH
.set CAN_CanIP__RX12_DL, CYREG_CAN0_RX12_DL
.set CAN_CanIP__RX12_ID, CYREG_CAN0_RX12_ID
.set CAN_CanIP__RX13_ACR, CYREG_CAN0_RX13_ACR
.set CAN_CanIP__RX13_ACRD, CYREG_CAN0_RX13_ACRD
.set CAN_CanIP__RX13_AMR, CYREG_CAN0_RX13_AMR
.set CAN_CanIP__RX13_AMRD, CYREG_CAN0_RX13_AMRD
.set CAN_CanIP__RX13_CMD, CYREG_CAN0_RX13_CMD
.set CAN_CanIP__RX13_DH, CYREG_CAN0_RX13_DH
.set CAN_CanIP__RX13_DL, CYREG_CAN0_RX13_DL
.set CAN_CanIP__RX13_ID, CYREG_CAN0_RX13_ID
.set CAN_CanIP__RX14_ACR, CYREG_CAN0_RX14_ACR
.set CAN_CanIP__RX14_ACRD, CYREG_CAN0_RX14_ACRD
.set CAN_CanIP__RX14_AMR, CYREG_CAN0_RX14_AMR
.set CAN_CanIP__RX14_AMRD, CYREG_CAN0_RX14_AMRD
.set CAN_CanIP__RX14_CMD, CYREG_CAN0_RX14_CMD
.set CAN_CanIP__RX14_DH, CYREG_CAN0_RX14_DH
.set CAN_CanIP__RX14_DL, CYREG_CAN0_RX14_DL
.set CAN_CanIP__RX14_ID, CYREG_CAN0_RX14_ID
.set CAN_CanIP__RX15_ACR, CYREG_CAN0_RX15_ACR
.set CAN_CanIP__RX15_ACRD, CYREG_CAN0_RX15_ACRD
.set CAN_CanIP__RX15_AMR, CYREG_CAN0_RX15_AMR
.set CAN_CanIP__RX15_AMRD, CYREG_CAN0_RX15_AMRD
.set CAN_CanIP__RX15_CMD, CYREG_CAN0_RX15_CMD
.set CAN_CanIP__RX15_DH, CYREG_CAN0_RX15_DH
.set CAN_CanIP__RX15_DL, CYREG_CAN0_RX15_DL
.set CAN_CanIP__RX15_ID, CYREG_CAN0_RX15_ID
.set CAN_CanIP__RX2_ACR, CYREG_CAN0_RX2_ACR
.set CAN_CanIP__RX2_ACRD, CYREG_CAN0_RX2_ACRD
.set CAN_CanIP__RX2_AMR, CYREG_CAN0_RX2_AMR
.set CAN_CanIP__RX2_AMRD, CYREG_CAN0_RX2_AMRD
.set CAN_CanIP__RX2_CMD, CYREG_CAN0_RX2_CMD
.set CAN_CanIP__RX2_DH, CYREG_CAN0_RX2_DH
.set CAN_CanIP__RX2_DL, CYREG_CAN0_RX2_DL
.set CAN_CanIP__RX2_ID, CYREG_CAN0_RX2_ID
.set CAN_CanIP__RX3_ACR, CYREG_CAN0_RX3_ACR
.set CAN_CanIP__RX3_ACRD, CYREG_CAN0_RX3_ACRD
.set CAN_CanIP__RX3_AMR, CYREG_CAN0_RX3_AMR
.set CAN_CanIP__RX3_AMRD, CYREG_CAN0_RX3_AMRD
.set CAN_CanIP__RX3_CMD, CYREG_CAN0_RX3_CMD
.set CAN_CanIP__RX3_DH, CYREG_CAN0_RX3_DH
.set CAN_CanIP__RX3_DL, CYREG_CAN0_RX3_DL
.set CAN_CanIP__RX3_ID, CYREG_CAN0_RX3_ID
.set CAN_CanIP__RX4_ACR, CYREG_CAN0_RX4_ACR
.set CAN_CanIP__RX4_ACRD, CYREG_CAN0_RX4_ACRD
.set CAN_CanIP__RX4_AMR, CYREG_CAN0_RX4_AMR
.set CAN_CanIP__RX4_AMRD, CYREG_CAN0_RX4_AMRD
.set CAN_CanIP__RX4_CMD, CYREG_CAN0_RX4_CMD
.set CAN_CanIP__RX4_DH, CYREG_CAN0_RX4_DH
.set CAN_CanIP__RX4_DL, CYREG_CAN0_RX4_DL
.set CAN_CanIP__RX4_ID, CYREG_CAN0_RX4_ID
.set CAN_CanIP__RX5_ACR, CYREG_CAN0_RX5_ACR
.set CAN_CanIP__RX5_ACRD, CYREG_CAN0_RX5_ACRD
.set CAN_CanIP__RX5_AMR, CYREG_CAN0_RX5_AMR
.set CAN_CanIP__RX5_AMRD, CYREG_CAN0_RX5_AMRD
.set CAN_CanIP__RX5_CMD, CYREG_CAN0_RX5_CMD
.set CAN_CanIP__RX5_DH, CYREG_CAN0_RX5_DH
.set CAN_CanIP__RX5_DL, CYREG_CAN0_RX5_DL
.set CAN_CanIP__RX5_ID, CYREG_CAN0_RX5_ID
.set CAN_CanIP__RX6_ACR, CYREG_CAN0_RX6_ACR
.set CAN_CanIP__RX6_ACRD, CYREG_CAN0_RX6_ACRD
.set CAN_CanIP__RX6_AMR, CYREG_CAN0_RX6_AMR
.set CAN_CanIP__RX6_AMRD, CYREG_CAN0_RX6_AMRD
.set CAN_CanIP__RX6_CMD, CYREG_CAN0_RX6_CMD
.set CAN_CanIP__RX6_DH, CYREG_CAN0_RX6_DH
.set CAN_CanIP__RX6_DL, CYREG_CAN0_RX6_DL
.set CAN_CanIP__RX6_ID, CYREG_CAN0_RX6_ID
.set CAN_CanIP__RX7_ACR, CYREG_CAN0_RX7_ACR
.set CAN_CanIP__RX7_ACRD, CYREG_CAN0_RX7_ACRD
.set CAN_CanIP__RX7_AMR, CYREG_CAN0_RX7_AMR
.set CAN_CanIP__RX7_AMRD, CYREG_CAN0_RX7_AMRD
.set CAN_CanIP__RX7_CMD, CYREG_CAN0_RX7_CMD
.set CAN_CanIP__RX7_DH, CYREG_CAN0_RX7_DH
.set CAN_CanIP__RX7_DL, CYREG_CAN0_RX7_DL
.set CAN_CanIP__RX7_ID, CYREG_CAN0_RX7_ID
.set CAN_CanIP__RX8_ACR, CYREG_CAN0_RX8_ACR
.set CAN_CanIP__RX8_ACRD, CYREG_CAN0_RX8_ACRD
.set CAN_CanIP__RX8_AMR, CYREG_CAN0_RX8_AMR
.set CAN_CanIP__RX8_AMRD, CYREG_CAN0_RX8_AMRD
.set CAN_CanIP__RX8_CMD, CYREG_CAN0_RX8_CMD
.set CAN_CanIP__RX8_DH, CYREG_CAN0_RX8_DH
.set CAN_CanIP__RX8_DL, CYREG_CAN0_RX8_DL
.set CAN_CanIP__RX8_ID, CYREG_CAN0_RX8_ID
.set CAN_CanIP__RX9_ACR, CYREG_CAN0_RX9_ACR
.set CAN_CanIP__RX9_ACRD, CYREG_CAN0_RX9_ACRD
.set CAN_CanIP__RX9_AMR, CYREG_CAN0_RX9_AMR
.set CAN_CanIP__RX9_AMRD, CYREG_CAN0_RX9_AMRD
.set CAN_CanIP__RX9_CMD, CYREG_CAN0_RX9_CMD
.set CAN_CanIP__RX9_DH, CYREG_CAN0_RX9_DH
.set CAN_CanIP__RX9_DL, CYREG_CAN0_RX9_DL
.set CAN_CanIP__RX9_ID, CYREG_CAN0_RX9_ID
.set CAN_CanIP__TX0_CMD, CYREG_CAN0_TX0_CMD
.set CAN_CanIP__TX0_DH, CYREG_CAN0_TX0_DH
.set CAN_CanIP__TX0_DL, CYREG_CAN0_TX0_DL
.set CAN_CanIP__TX0_ID, CYREG_CAN0_TX0_ID
.set CAN_CanIP__TX1_CMD, CYREG_CAN0_TX1_CMD
.set CAN_CanIP__TX1_DH, CYREG_CAN0_TX1_DH
.set CAN_CanIP__TX1_DL, CYREG_CAN0_TX1_DL
.set CAN_CanIP__TX1_ID, CYREG_CAN0_TX1_ID
.set CAN_CanIP__TX2_CMD, CYREG_CAN0_TX2_CMD
.set CAN_CanIP__TX2_DH, CYREG_CAN0_TX2_DH
.set CAN_CanIP__TX2_DL, CYREG_CAN0_TX2_DL
.set CAN_CanIP__TX2_ID, CYREG_CAN0_TX2_ID
.set CAN_CanIP__TX3_CMD, CYREG_CAN0_TX3_CMD
.set CAN_CanIP__TX3_DH, CYREG_CAN0_TX3_DH
.set CAN_CanIP__TX3_DL, CYREG_CAN0_TX3_DL
.set CAN_CanIP__TX3_ID, CYREG_CAN0_TX3_ID
.set CAN_CanIP__TX4_CMD, CYREG_CAN0_TX4_CMD
.set CAN_CanIP__TX4_DH, CYREG_CAN0_TX4_DH
.set CAN_CanIP__TX4_DL, CYREG_CAN0_TX4_DL
.set CAN_CanIP__TX4_ID, CYREG_CAN0_TX4_ID
.set CAN_CanIP__TX5_CMD, CYREG_CAN0_TX5_CMD
.set CAN_CanIP__TX5_DH, CYREG_CAN0_TX5_DH
.set CAN_CanIP__TX5_DL, CYREG_CAN0_TX5_DL
.set CAN_CanIP__TX5_ID, CYREG_CAN0_TX5_ID
.set CAN_CanIP__TX6_CMD, CYREG_CAN0_TX6_CMD
.set CAN_CanIP__TX6_DH, CYREG_CAN0_TX6_DH
.set CAN_CanIP__TX6_DL, CYREG_CAN0_TX6_DL
.set CAN_CanIP__TX6_ID, CYREG_CAN0_TX6_ID
.set CAN_CanIP__TX7_CMD, CYREG_CAN0_TX7_CMD
.set CAN_CanIP__TX7_DH, CYREG_CAN0_TX7_DH
.set CAN_CanIP__TX7_DL, CYREG_CAN0_TX7_DL
.set CAN_CanIP__TX7_ID, CYREG_CAN0_TX7_ID

/* CAN_isr */
.set CAN_isr__INTC_CLR_EN_REG, CYREG_NVIC_CLRENA0
.set CAN_isr__INTC_CLR_PD_REG, CYREG_NVIC_CLRPEND0
.set CAN_isr__INTC_MASK, 0x10000
.set CAN_isr__INTC_NUMBER, 16
.set CAN_isr__INTC_PRIOR_NUM, 7
.set CAN_isr__INTC_PRIOR_REG, CYREG_NVIC_PRI_16
.set CAN_isr__INTC_SET_EN_REG, CYREG_NVIC_SETENA0
.set CAN_isr__INTC_SET_PD_REG, CYREG_NVIC_SETPEND0

/* LED */
.set LED__0__INTTYPE, CYREG_PICU2_INTTYPE1
.set LED__0__MASK, 0x02
.set LED__0__PC, CYREG_PRT2_PC1
.set LED__0__PORT, 2
.set LED__0__SHIFT, 1
.set LED__AG, CYREG_PRT2_AG
.set LED__AMUX, CYREG_PRT2_AMUX
.set LED__BIE, CYREG_PRT2_BIE
.set LED__BIT_MASK, CYREG_PRT2_BIT_MASK
.set LED__BYP, CYREG_PRT2_BYP
.set LED__CTL, CYREG_PRT2_CTL
.set LED__DM0, CYREG_PRT2_DM0
.set LED__DM1, CYREG_PRT2_DM1
.set LED__DM2, CYREG_PRT2_DM2
.set LED__DR, CYREG_PRT2_DR
.set LED__INP_DIS, CYREG_PRT2_INP_DIS
.set LED__INTTYPE_BASE, CYDEV_PICU_INTTYPE_PICU2_BASE
.set LED__LCD_COM_SEG, CYREG_PRT2_LCD_COM_SEG
.set LED__LCD_EN, CYREG_PRT2_LCD_EN
.set LED__MASK, 0x02
.set LED__PORT, 2
.set LED__PRT, CYREG_PRT2_PRT
.set LED__PRTDSI__CAPS_SEL, CYREG_PRT2_CAPS_SEL
.set LED__PRTDSI__DBL_SYNC_IN, CYREG_PRT2_DBL_SYNC_IN
.set LED__PRTDSI__OE_SEL0, CYREG_PRT2_OE_SEL0
.set LED__PRTDSI__OE_SEL1, CYREG_PRT2_OE_SEL1
.set LED__PRTDSI__OUT_SEL0, CYREG_PRT2_OUT_SEL0
.set LED__PRTDSI__OUT_SEL1, CYREG_PRT2_OUT_SEL1
.set LED__PRTDSI__SYNC_OUT, CYREG_PRT2_SYNC_OUT
.set LED__PS, CYREG_PRT2_PS
.set LED__SHIFT, 1
.set LED__SLW, CYREG_PRT2_SLW

/* RX_1 */
.set RX_1__0__INTTYPE, CYREG_PICU12_INTTYPE2
.set RX_1__0__MASK, 0x04
.set RX_1__0__PC, CYREG_PRT12_PC2
.set RX_1__0__PORT, 12
.set RX_1__0__SHIFT, 2
.set RX_1__AG, CYREG_PRT12_AG
.set RX_1__BIE, CYREG_PRT12_BIE
.set RX_1__BIT_MASK, CYREG_PRT12_BIT_MASK
.set RX_1__BYP, CYREG_PRT12_BYP
.set RX_1__DM0, CYREG_PRT12_DM0
.set RX_1__DM1, CYREG_PRT12_DM1
.set RX_1__DM2, CYREG_PRT12_DM2
.set RX_1__DR, CYREG_PRT12_DR
.set RX_1__INP_DIS, CYREG_PRT12_INP_DIS
.set RX_1__INTTYPE_BASE, CYDEV_PICU_INTTYPE_PICU12_BASE
.set RX_1__MASK, 0x04
.set RX_1__PORT, 12
.set RX_1__PRT, CYREG_PRT12_PRT
.set RX_1__PRTDSI__DBL_SYNC_IN, CYREG_PRT12_DBL_SYNC_IN
.set RX_1__PRTDSI__OE_SEL0, CYREG_PRT12_OE_SEL0
.set RX_1__PRTDSI__OE_SEL1, CYREG_PRT12_OE_SEL1
.set RX_1__PRTDSI__OUT_SEL0, CYREG_PRT12_OUT_SEL0
.set RX_1__PRTDSI__OUT_SEL1, CYREG_PRT12_OUT_SEL1
.set RX_1__PRTDSI__SYNC_OUT, CYREG_PRT12_SYNC_OUT
.set RX_1__PS, CYREG_PRT12_PS
.set RX_1__SHIFT, 2
.set RX_1__SIO_CFG, CYREG_PRT12_SIO_CFG
.set RX_1__SIO_DIFF, CYREG_PRT12_SIO_DIFF
.set RX_1__SIO_HYST_EN, CYREG_PRT12_SIO_HYST_EN
.set RX_1__SIO_REG_HIFREQ, CYREG_PRT12_SIO_REG_HIFREQ
.set RX_1__SLW, CYREG_PRT12_SLW

/* TX_1 */
.set TX_1__0__INTTYPE, CYREG_PICU12_INTTYPE3
.set TX_1__0__MASK, 0x08
.set TX_1__0__PC, CYREG_PRT12_PC3
.set TX_1__0__PORT, 12
.set TX_1__0__SHIFT, 3
.set TX_1__AG, CYREG_PRT12_AG
.set TX_1__BIE, CYREG_PRT12_BIE
.set TX_1__BIT_MASK, CYREG_PRT12_BIT_MASK
.set TX_1__BYP, CYREG_PRT12_BYP
.set TX_1__DM0, CYREG_PRT12_DM0
.set TX_1__DM1, CYREG_PRT12_DM1
.set TX_1__DM2, CYREG_PRT12_DM2
.set TX_1__DR, CYREG_PRT12_DR
.set TX_1__INP_DIS, CYREG_PRT12_INP_DIS
.set TX_1__INTTYPE_BASE, CYDEV_PICU_INTTYPE_PICU12_BASE
.set TX_1__MASK, 0x08
.set TX_1__PORT, 12
.set TX_1__PRT, CYREG_PRT12_PRT
.set TX_1__PRTDSI__DBL_SYNC_IN, CYREG_PRT12_DBL_SYNC_IN
.set TX_1__PRTDSI__OE_SEL0, CYREG_PRT12_OE_SEL0
.set TX_1__PRTDSI__OE_SEL1, CYREG_PRT12_OE_SEL1
.set TX_1__PRTDSI__OUT_SEL0, CYREG_PRT12_OUT_SEL0
.set TX_1__PRTDSI__OUT_SEL1, CYREG_PRT12_OUT_SEL1
.set TX_1__PRTDSI__SYNC_OUT, CYREG_PRT12_SYNC_OUT
.set TX_1__PS, CYREG_PRT12_PS
.set TX_1__SHIFT, 3
.set TX_1__SIO_CFG, CYREG_PRT12_SIO_CFG
.set TX_1__SIO_DIFF, CYREG_PRT12_SIO_DIFF
.set TX_1__SIO_HYST_EN, CYREG_PRT12_SIO_HYST_EN
.set TX_1__SIO_REG_HIFREQ, CYREG_PRT12_SIO_REG_HIFREQ
.set TX_1__SLW, CYREG_PRT12_SLW

/* USBUART_arb_int */
.set USBUART_arb_int__INTC_CLR_EN_REG, CYREG_NVIC_CLRENA0
.set USBUART_arb_int__INTC_CLR_PD_REG, CYREG_NVIC_CLRPEND0
.set USBUART_arb_int__INTC_MASK, 0x400000
.set USBUART_arb_int__INTC_NUMBER, 22
.set USBUART_arb_int__INTC_PRIOR_NUM, 7
.set USBUART_arb_int__INTC_PRIOR_REG, CYREG_NVIC_PRI_22
.set USBUART_arb_int__INTC_SET_EN_REG, CYREG_NVIC_SETENA0
.set USBUART_arb_int__INTC_SET_PD_REG, CYREG_NVIC_SETPEND0

/* USBUART_bus_reset */
.set USBUART_bus_reset__INTC_CLR_EN_REG, CYREG_NVIC_CLRENA0
.set USBUART_bus_reset__INTC_CLR_PD_REG, CYREG_NVIC_CLRPEND0
.set USBUART_bus_reset__INTC_MASK, 0x800000
.set USBUART_bus_reset__INTC_NUMBER, 23
.set USBUART_bus_reset__INTC_PRIOR_NUM, 7
.set USBUART_bus_reset__INTC_PRIOR_REG, CYREG_NVIC_PRI_23
.set USBUART_bus_reset__INTC_SET_EN_REG, CYREG_NVIC_SETENA0
.set USBUART_bus_reset__INTC_SET_PD_REG, CYREG_NVIC_SETPEND0

/* USBUART_Dm */
.set USBUART_Dm__0__INTTYPE, CYREG_PICU15_INTTYPE7
.set USBUART_Dm__0__MASK, 0x80
.set USBUART_Dm__0__PC, CYREG_IO_PC_PRT15_7_6_PC1
.set USBUART_Dm__0__PORT, 15
.set USBUART_Dm__0__SHIFT, 7
.set USBUART_Dm__AG, CYREG_PRT15_AG
.set USBUART_Dm__AMUX, CYREG_PRT15_AMUX
.set USBUART_Dm__BIE, CYREG_PRT15_BIE
.set USBUART_Dm__BIT_MASK, CYREG_PRT15_BIT_MASK
.set USBUART_Dm__BYP, CYREG_PRT15_BYP
.set USBUART_Dm__CTL, CYREG_PRT15_CTL
.set USBUART_Dm__DM0, CYREG_PRT15_DM0
.set USBUART_Dm__DM1, CYREG_PRT15_DM1
.set USBUART_Dm__DM2, CYREG_PRT15_DM2
.set USBUART_Dm__DR, CYREG_PRT15_DR
.set USBUART_Dm__INP_DIS, CYREG_PRT15_INP_DIS
.set USBUART_Dm__INTTYPE_BASE, CYDEV_PICU_INTTYPE_PICU15_BASE
.set USBUART_Dm__LCD_COM_SEG, CYREG_PRT15_LCD_COM_SEG
.set USBUART_Dm__LCD_EN, CYREG_PRT15_LCD_EN
.set USBUART_Dm__MASK, 0x80
.set USBUART_Dm__PORT, 15
.set USBUART_Dm__PRT, CYREG_PRT15_PRT
.set USBUART_Dm__PRTDSI__CAPS_SEL, CYREG_PRT15_CAPS_SEL
.set USBUART_Dm__PRTDSI__DBL_SYNC_IN, CYREG_PRT15_DBL_SYNC_IN
.set USBUART_Dm__PRTDSI__OE_SEL0, CYREG_PRT15_OE_SEL0
.set USBUART_Dm__PRTDSI__OE_SEL1, CYREG_PRT15_OE_SEL1
.set USBUART_Dm__PRTDSI__OUT_SEL0, CYREG_PRT15_OUT_SEL0
.set USBUART_Dm__PRTDSI__OUT_SEL1, CYREG_PRT15_OUT_SEL1
.set USBUART_Dm__PRTDSI__SYNC_OUT, CYREG_PRT15_SYNC_OUT
.set USBUART_Dm__PS, CYREG_PRT15_PS
.set USBUART_Dm__SHIFT, 7
.set USBUART_Dm__SLW, CYREG_PRT15_SLW

/* USBUART_Dp */
.set USBUART_Dp__0__INTTYPE, CYREG_PICU15_INTTYPE6
.set USBUART_Dp__0__MASK, 0x40
.set USBUART_Dp__0__PC, CYREG_IO_PC_PRT15_7_6_PC0
.set USBUART_Dp__0__PORT, 15
.set USBUART_Dp__0__SHIFT, 6
.set USBUART_Dp__AG, CYREG_PRT15_AG
.set USBUART_Dp__AMUX, CYREG_PRT15_AMUX
.set USBUART_Dp__BIE, CYREG_PRT15_BIE
.set USBUART_Dp__BIT_MASK, CYREG_PRT15_BIT_MASK
.set USBUART_Dp__BYP, CYREG_PRT15_BYP
.set USBUART_Dp__CTL, CYREG_PRT15_CTL
.set USBUART_Dp__DM0, CYREG_PRT15_DM0
.set USBUART_Dp__DM1, CYREG_PRT15_DM1
.set USBUART_Dp__DM2, CYREG_PRT15_DM2
.set USBUART_Dp__DR, CYREG_PRT15_DR
.set USBUART_Dp__INP_DIS, CYREG_PRT15_INP_DIS
.set USBUART_Dp__INTSTAT, CYREG_PICU15_INTSTAT
.set USBUART_Dp__INTTYPE_BASE, CYDEV_PICU_INTTYPE_PICU15_BASE
.set USBUART_Dp__LCD_COM_SEG, CYREG_PRT15_LCD_COM_SEG
.set USBUART_Dp__LCD_EN, CYREG_PRT15_LCD_EN
.set USBUART_Dp__MASK, 0x40
.set USBUART_Dp__PORT, 15
.set USBUART_Dp__PRT, CYREG_PRT15_PRT
.set USBUART_Dp__PRTDSI__CAPS_SEL, CYREG_PRT15_CAPS_SEL
.set USBUART_Dp__PRTDSI__DBL_SYNC_IN, CYREG_PRT15_DBL_SYNC_IN
.set USBUART_Dp__PRTDSI__OE_SEL0, CYREG_PRT15_OE_SEL0
.set USBUART_Dp__PRTDSI__OE_SEL1, CYREG_PRT15_OE_SEL1
.set USBUART_Dp__PRTDSI__OUT_SEL0, CYREG_PRT15_OUT_SEL0
.set USBUART_Dp__PRTDSI__OUT_SEL1, CYREG_PRT15_OUT_SEL1
.set USBUART_Dp__PRTDSI__SYNC_OUT, CYREG_PRT15_SYNC_OUT
.set USBUART_Dp__PS, CYREG_PRT15_PS
.set USBUART_Dp__SHIFT, 6
.set USBUART_Dp__SLW, CYREG_PRT15_SLW
.set USBUART_Dp__SNAP, CYREG_PICU_15_SNAP_15

/* USBUART_dp_int */
.set USBUART_dp_int__INTC_CLR_EN_REG, CYREG_NVIC_CLRENA0
.set USBUART_dp_int__INTC_CLR_PD_REG, CYREG_NVIC_CLRPEND0
.set USBUART_dp_int__INTC_MASK, 0x1000
.set USBUART_dp_int__INTC_NUMBER, 12
.set USBUART_dp_int__INTC_PRIOR_NUM, 7
.set USBUART_dp_int__INTC_PRIOR_REG, CYREG_NVIC_PRI_12
.set USBUART_dp_int__INTC_SET_EN_REG, CYREG_NVIC_SETENA0
.set USBUART_dp_int__INTC_SET_PD_REG, CYREG_NVIC_SETPEND0

/* USBUART_ep_0 */
.set USBUART_ep_0__INTC_CLR_EN_REG, CYREG_NVIC_CLRENA0
.set USBUART_ep_0__INTC_CLR_PD_REG, CYREG_NVIC_CLRPEND0
.set USBUART_ep_0__INTC_MASK, 0x1000000
.set USBUART_ep_0__INTC_NUMBER, 24
.set USBUART_ep_0__INTC_PRIOR_NUM, 7
.set USBUART_ep_0__INTC_PRIOR_REG, CYREG_NVIC_PRI_24
.set USBUART_ep_0__INTC_SET_EN_REG, CYREG_NVIC_SETENA0
.set USBUART_ep_0__INTC_SET_PD_REG, CYREG_NVIC_SETPEND0

/* USBUART_ep_1 */
.set USBUART_ep_1__INTC_CLR_EN_REG, CYREG_NVIC_CLRENA0
.set USBUART_ep_1__INTC_CLR_PD_REG, CYREG_NVIC_CLRPEND0
.set USBUART_ep_1__INTC_MASK, 0x01
.set USBUART_ep_1__INTC_NUMBER, 0
.set USBUART_ep_1__INTC_PRIOR_NUM, 7
.set USBUART_ep_1__INTC_PRIOR_REG, CYREG_NVIC_PRI_0
.set USBUART_ep_1__INTC_SET_EN_REG, CYREG_NVIC_SETENA0
.set USBUART_ep_1__INTC_SET_PD_REG, CYREG_NVIC_SETPEND0

/* USBUART_ep_2 */
.set USBUART_ep_2__INTC_CLR_EN_REG, CYREG_NVIC_CLRENA0
.set USBUART_ep_2__INTC_CLR_PD_REG, CYREG_NVIC_CLRPEND0
.set USBUART_ep_2__INTC_MASK, 0x02
.set USBUART_ep_2__INTC_NUMBER, 1
.set USBUART_ep_2__INTC_PRIOR_NUM, 7
.set USBUART_ep_2__INTC_PRIOR_REG, CYREG_NVIC_PRI_1
.set USBUART_ep_2__INTC_SET_EN_REG, CYREG_NVIC_SETENA0
.set USBUART_ep_2__INTC_SET_PD_REG, CYREG_NVIC_SETPEND0

/* USBUART_ep_3 */
.set USBUART_ep_3__INTC_CLR_EN_REG, CYREG_NVIC_CLRENA0
.set USBUART_ep_3__INTC_CLR_PD_REG, CYREG_NVIC_CLRPEND0
.set USBUART_ep_3__INTC_MASK, 0x04
.set USBUART_ep_3__INTC_NUMBER, 2
.set USBUART_ep_3__INTC_PRIOR_NUM, 7
.set USBUART_ep_3__INTC_PRIOR_REG, CYREG_NVIC_PRI_2
.set USBUART_ep_3__INTC_SET_EN_REG, CYREG_NVIC_SETENA0
.set USBUART_ep_3__INTC_SET_PD_REG, CYREG_NVIC_SETPEND0

/* USBUART_sof_int */
.set USBUART_sof_int__INTC_CLR_EN_REG, CYREG_NVIC_CLRENA0
.set USBUART_sof_int__INTC_CLR_PD_REG, CYREG_NVIC_CLRPEND0
.set USBUART_sof_int__INTC_MASK, 0x200000
.set USBUART_sof_int__INTC_NUMBER, 21
.set USBUART_sof_int__INTC_PRIOR_NUM, 7
.set USBUART_sof_int__INTC_PRIOR_REG, CYREG_NVIC_PRI_21
.set USBUART_sof_int__INTC_SET_EN_REG, CYREG_NVIC_SETENA0
.set USBUART_sof_int__INTC_SET_PD_REG, CYREG_NVIC_SETPEND0

/* USBUART_USB */
.set USBUART_USB__ARB_CFG, CYREG_USB_ARB_CFG
.set USBUART_USB__ARB_EP1_CFG, CYREG_USB_ARB_EP1_CFG
.set USBUART_USB__ARB_EP1_INT_EN, CYREG_USB_ARB_EP1_INT_EN
.set USBUART_USB__ARB_EP1_SR, CYREG_USB_ARB_EP1_SR
.set USBUART_USB__ARB_EP2_CFG, CYREG_USB_ARB_EP2_CFG
.set USBUART_USB__ARB_EP2_INT_EN, CYREG_USB_ARB_EP2_INT_EN
.set USBUART_USB__ARB_EP2_SR, CYREG_USB_ARB_EP2_SR
.set USBUART_USB__ARB_EP3_CFG, CYREG_USB_ARB_EP3_CFG
.set USBUART_USB__ARB_EP3_INT_EN, CYREG_USB_ARB_EP3_INT_EN
.set USBUART_USB__ARB_EP3_SR, CYREG_USB_ARB_EP3_SR
.set USBUART_USB__ARB_EP4_CFG, CYREG_USB_ARB_EP4_CFG
.set USBUART_USB__ARB_EP4_INT_EN, CYREG_USB_ARB_EP4_INT_EN
.set USBUART_USB__ARB_EP4_SR, CYREG_USB_ARB_EP4_SR
.set USBUART_USB__ARB_EP5_CFG, CYREG_USB_ARB_EP5_CFG
.set USBUART_USB__ARB_EP5_INT_EN, CYREG_USB_ARB_EP5_INT_EN
.set USBUART_USB__ARB_EP5_SR, CYREG_USB_ARB_EP5_SR
.set USBUART_USB__ARB_EP6_CFG, CYREG_USB_ARB_EP6_CFG
.set USBUART_USB__ARB_EP6_INT_EN, CYREG_USB_ARB_EP6_INT_EN
.set USBUART_USB__ARB_EP6_SR, CYREG_USB_ARB_EP6_SR
.set USBUART_USB__ARB_EP7_CFG, CYREG_USB_ARB_EP7_CFG
.set USBUART_USB__ARB_EP7_INT_EN, CYREG_USB_ARB_EP7_INT_EN
.set USBUART_USB__ARB_EP7_SR, CYREG_USB_ARB_EP7_SR
.set USBUART_USB__ARB_EP8_CFG, CYREG_USB_ARB_EP8_CFG
.set USBUART_USB__ARB_EP8_INT_EN, CYREG_USB_ARB_EP8_INT_EN
.set USBUART_USB__ARB_EP8_SR, CYREG_USB_ARB_EP8_SR
.set USBUART_USB__ARB_INT_EN, CYREG_USB_ARB_INT_EN
.set USBUART_USB__ARB_INT_SR, CYREG_USB_ARB_INT_SR
.set USBUART_USB__ARB_RW1_DR, CYREG_USB_ARB_RW1_DR
.set USBUART_USB__ARB_RW1_RA, CYREG_USB_ARB_RW1_RA
.set USBUART_USB__ARB_RW1_RA_MSB, CYREG_USB_ARB_RW1_RA_MSB
.set USBUART_USB__ARB_RW1_WA, CYREG_USB_ARB_RW1_WA
.set USBUART_USB__ARB_RW1_WA_MSB, CYREG_USB_ARB_RW1_WA_MSB
.set USBUART_USB__ARB_RW2_DR, CYREG_USB_ARB_RW2_DR
.set USBUART_USB__ARB_RW2_RA, CYREG_USB_ARB_RW2_RA
.set USBUART_USB__ARB_RW2_RA_MSB, CYREG_USB_ARB_RW2_RA_MSB
.set USBUART_USB__ARB_RW2_WA, CYREG_USB_ARB_RW2_WA
.set USBUART_USB__ARB_RW2_WA_MSB, CYREG_USB_ARB_RW2_WA_MSB
.set USBUART_USB__ARB_RW3_DR, CYREG_USB_ARB_RW3_DR
.set USBUART_USB__ARB_RW3_RA, CYREG_USB_ARB_RW3_RA
.set USBUART_USB__ARB_RW3_RA_MSB, CYREG_USB_ARB_RW3_RA_MSB
.set USBUART_USB__ARB_RW3_WA, CYREG_USB_ARB_RW3_WA
.set USBUART_USB__ARB_RW3_WA_MSB, CYREG_USB_ARB_RW3_WA_MSB
.set USBUART_USB__ARB_RW4_DR, CYREG_USB_ARB_RW4_DR
.set USBUART_USB__ARB_RW4_RA, CYREG_USB_ARB_RW4_RA
.set USBUART_USB__ARB_RW4_RA_MSB, CYREG_USB_ARB_RW4_RA_MSB
.set USBUART_USB__ARB_RW4_WA, CYREG_USB_ARB_RW4_WA
.set USBUART_USB__ARB_RW4_WA_MSB, CYREG_USB_ARB_RW4_WA_MSB
.set USBUART_USB__ARB_RW5_DR, CYREG_USB_ARB_RW5_DR
.set USBUART_USB__ARB_RW5_RA, CYREG_USB_ARB_RW5_RA
.set USBUART_USB__ARB_RW5_RA_MSB, CYREG_USB_ARB_RW5_RA_MSB
.set USBUART_USB__ARB_RW5_WA, CYREG_USB_ARB_RW5_WA
.set USBUART_USB__ARB_RW5_WA_MSB, CYREG_USB_ARB_RW5_WA_MSB
.set USBUART_USB__ARB_RW6_DR, CYREG_USB_ARB_RW6_DR
.set USBUART_USB__ARB_RW6_RA, CYREG_USB_ARB_RW6_RA
.set USBUART_USB__ARB_RW6_RA_MSB, CYREG_USB_ARB_RW6_RA_MSB
.set USBUART_USB__ARB_RW6_WA, CYREG_USB_ARB_RW6_WA
.set USBUART_USB__ARB_RW6_WA_MSB, CYREG_USB_ARB_RW6_WA_MSB
.set USBUART_USB__ARB_RW7_DR, CYREG_USB_ARB_RW7_DR
.set USBUART_USB__ARB_RW7_RA, CYREG_USB_ARB_RW7_RA
.set USBUART_USB__ARB_RW7_RA_MSB, CYREG_USB_ARB_RW7_RA_MSB
.set USBUART_USB__ARB_RW7_WA, CYREG_USB_ARB_RW7_WA
.set USBUART_USB__ARB_RW7_WA_MSB, CYREG_USB_ARB_RW7_WA_MSB
.set USBUART_USB__ARB_RW8_DR, CYREG_USB_ARB_RW8_DR
.set USBUART_USB__ARB_RW8_RA, CYREG_USB_ARB_RW8_RA
.set USBUART_USB__ARB_RW8_RA_MSB, CYREG_USB_ARB_RW8_RA_MSB
.set USBUART_USB__ARB_RW8_WA, CYREG_USB_ARB_RW8_WA
.set USBUART_USB__ARB_RW8_WA_MSB, CYREG_USB_ARB_RW8_WA_MSB
.set USBUART_USB__BUF_SIZE, CYREG_USB_BUF_SIZE
.set USBUART_USB__BUS_RST_CNT, CYREG_USB_BUS_RST_CNT
.set USBUART_USB__CR0, CYREG_USB_CR0
.set USBUART_USB__CR1, CYREG_USB_CR1
.set USBUART_USB__CWA, CYREG_USB_CWA
.set USBUART_USB__CWA_MSB, CYREG_USB_CWA_MSB
.set USBUART_USB__DMA_THRES, CYREG_USB_DMA_THRES
.set USBUART_USB__DMA_THRES_MSB, CYREG_USB_DMA_THRES_MSB
.set USBUART_USB__DYN_RECONFIG, CYREG_USB_DYN_RECONFIG
.set USBUART_USB__EP_ACTIVE, CYREG_USB_EP_ACTIVE
.set USBUART_USB__EP_TYPE, CYREG_USB_EP_TYPE
.set USBUART_USB__EP0_CNT, CYREG_USB_EP0_CNT
.set USBUART_USB__EP0_CR, CYREG_USB_EP0_CR
.set USBUART_USB__EP0_DR0, CYREG_USB_EP0_DR0
.set USBUART_USB__EP0_DR1, CYREG_USB_EP0_DR1
.set USBUART_USB__EP0_DR2, CYREG_USB_EP0_DR2
.set USBUART_USB__EP0_DR3, CYREG_USB_EP0_DR3
.set USBUART_USB__EP0_DR4, CYREG_USB_EP0_DR4
.set USBUART_USB__EP0_DR5, CYREG_USB_EP0_DR5
.set USBUART_USB__EP0_DR6, CYREG_USB_EP0_DR6
.set USBUART_USB__EP0_DR7, CYREG_USB_EP0_DR7
.set USBUART_USB__MEM_DATA, CYREG_USB_MEM_DATA_MBASE
.set USBUART_USB__PM_ACT_CFG, CYREG_PM_ACT_CFG5
.set USBUART_USB__PM_ACT_MSK, 0x01
.set USBUART_USB__PM_STBY_CFG, CYREG_PM_STBY_CFG5
.set USBUART_USB__PM_STBY_MSK, 0x01
.set USBUART_USB__SIE_EP_INT_EN, CYREG_USB_SIE_EP_INT_EN
.set USBUART_USB__SIE_EP_INT_SR, CYREG_USB_SIE_EP_INT_SR
.set USBUART_USB__SIE_EP1_CNT0, CYREG_USB_SIE_EP1_CNT0
.set USBUART_USB__SIE_EP1_CNT1, CYREG_USB_SIE_EP1_CNT1
.set USBUART_USB__SIE_EP1_CR0, CYREG_USB_SIE_EP1_CR0
.set USBUART_USB__SIE_EP2_CNT0, CYREG_USB_SIE_EP2_CNT0
.set USBUART_USB__SIE_EP2_CNT1, CYREG_USB_SIE_EP2_CNT1
.set USBUART_USB__SIE_EP2_CR0, CYREG_USB_SIE_EP2_CR0
.set USBUART_USB__SIE_EP3_CNT0, CYREG_USB_SIE_EP3_CNT0
.set USBUART_USB__SIE_EP3_CNT1, CYREG_USB_SIE_EP3_CNT1
.set USBUART_USB__SIE_EP3_CR0, CYREG_USB_SIE_EP3_CR0
.set USBUART_USB__SIE_EP4_CNT0, CYREG_USB_SIE_EP4_CNT0
.set USBUART_USB__SIE_EP4_CNT1, CYREG_USB_SIE_EP4_CNT1
.set USBUART_USB__SIE_EP4_CR0, CYREG_USB_SIE_EP4_CR0
.set USBUART_USB__SIE_EP5_CNT0, CYREG_USB_SIE_EP5_CNT0
.set USBUART_USB__SIE_EP5_CNT1, CYREG_USB_SIE_EP5_CNT1
.set USBUART_USB__SIE_EP5_CR0, CYREG_USB_SIE_EP5_CR0
.set USBUART_USB__SIE_EP6_CNT0, CYREG_USB_SIE_EP6_CNT0
.set USBUART_USB__SIE_EP6_CNT1, CYREG_USB_SIE_EP6_CNT1
.set USBUART_USB__SIE_EP6_CR0, CYREG_USB_SIE_EP6_CR0
.set USBUART_USB__SIE_EP7_CNT0, CYREG_USB_SIE_EP7_CNT0
.set USBUART_USB__SIE_EP7_CNT1, CYREG_USB_SIE_EP7_CNT1
.set USBUART_USB__SIE_EP7_CR0, CYREG_USB_SIE_EP7_CR0
.set USBUART_USB__SIE_EP8_CNT0, CYREG_USB_SIE_EP8_CNT0
.set USBUART_USB__SIE_EP8_CNT1, CYREG_USB_SIE_EP8_CNT1
.set USBUART_USB__SIE_EP8_CR0, CYREG_USB_SIE_EP8_CR0
.set USBUART_USB__SOF0, CYREG_USB_SOF0
.set USBUART_USB__SOF1, CYREG_USB_SOF1
.set USBUART_USB__USB_CLK_EN, CYREG_USB_USB_CLK_EN
.set USBUART_USB__USBIO_CR0, CYREG_USB_USBIO_CR0
.set USBUART_USB__USBIO_CR1, CYREG_USB_USBIO_CR1

/* Control_Reg_1 */
.set Control_Reg_1_Sync_ctrl_reg__0__MASK, 0x01
.set Control_Reg_1_Sync_ctrl_reg__0__POS, 0
.set Control_Reg_1_Sync_ctrl_reg__16BIT_CONTROL_AUX_CTL_REG, CYREG_B0_UDB13_14_ACTL
.set Control_Reg_1_Sync_ctrl_reg__16BIT_CONTROL_CONTROL_REG, CYREG_B0_UDB13_14_CTL
.set Control_Reg_1_Sync_ctrl_reg__16BIT_CONTROL_COUNT_REG, CYREG_B0_UDB13_14_CTL
.set Control_Reg_1_Sync_ctrl_reg__16BIT_COUNT_CONTROL_REG, CYREG_B0_UDB13_14_CTL
.set Control_Reg_1_Sync_ctrl_reg__16BIT_COUNT_COUNT_REG, CYREG_B0_UDB13_14_CTL
.set Control_Reg_1_Sync_ctrl_reg__16BIT_MASK_MASK_REG, CYREG_B0_UDB13_14_MSK
.set Control_Reg_1_Sync_ctrl_reg__16BIT_MASK_PERIOD_REG, CYREG_B0_UDB13_14_MSK
.set Control_Reg_1_Sync_ctrl_reg__16BIT_PERIOD_MASK_REG, CYREG_B0_UDB13_14_MSK
.set Control_Reg_1_Sync_ctrl_reg__16BIT_PERIOD_PERIOD_REG, CYREG_B0_UDB13_14_MSK
.set Control_Reg_1_Sync_ctrl_reg__CONTROL_AUX_CTL_REG, CYREG_B0_UDB13_ACTL
.set Control_Reg_1_Sync_ctrl_reg__CONTROL_REG, CYREG_B0_UDB13_CTL
.set Control_Reg_1_Sync_ctrl_reg__CONTROL_ST_REG, CYREG_B0_UDB13_ST_CTL
.set Control_Reg_1_Sync_ctrl_reg__COUNT_REG, CYREG_B0_UDB13_CTL
.set Control_Reg_1_Sync_ctrl_reg__COUNT_ST_REG, CYREG_B0_UDB13_ST_CTL
.set Control_Reg_1_Sync_ctrl_reg__MASK, 0x01
.set Control_Reg_1_Sync_ctrl_reg__MASK_CTL_AUX_CTL_REG, CYREG_B0_UDB13_MSK_ACTL
.set Control_Reg_1_Sync_ctrl_reg__PER_CTL_AUX_CTL_REG, CYREG_B0_UDB13_MSK_ACTL
.set Control_Reg_1_Sync_ctrl_reg__PERIOD_REG, CYREG_B0_UDB13_MSK

/* Miscellaneous */
.set BCLK__BUS_CLK__HZ, 72000000
.set BCLK__BUS_CLK__KHZ, 72000
.set BCLK__BUS_CLK__MHZ, 72
.set CYDEV_CHIP_DIE_LEOPARD, 1
.set CYDEV_CHIP_DIE_PSOC4A, 12
.set CYDEV_CHIP_DIE_PSOC5LP, 19
.set CYDEV_CHIP_DIE_PSOC5TM, 20
.set CYDEV_CHIP_DIE_TMA4, 2
.set CYDEV_CHIP_DIE_UNKNOWN, 0
.set CYDEV_CHIP_FAMILY_FM0P, 4
.set CYDEV_CHIP_FAMILY_FM3, 5
.set CYDEV_CHIP_FAMILY_FM4, 6
.set CYDEV_CHIP_FAMILY_PSOC3, 1
.set CYDEV_CHIP_FAMILY_PSOC4, 2
.set CYDEV_CHIP_FAMILY_PSOC5, 3
.set CYDEV_CHIP_FAMILY_UNKNOWN, 0
.set CYDEV_CHIP_FAMILY_USED, CYDEV_CHIP_FAMILY_PSOC5
.set CYDEV_CHIP_JTAG_ID, 0x2E161069
.set CYDEV_CHIP_MEMBER_3A, 1
.set CYDEV_CHIP_MEMBER_4A, 12
.set CYDEV_CHIP_MEMBER_4C, 18
.set CYDEV_CHIP_MEMBER_4D, 8
.set CYDEV_CHIP_MEMBER_4E, 4
.set CYDEV_CHIP_MEMBER_4F, 13
.set CYDEV_CHIP_MEMBER_4G, 2
.set CYDEV_CHIP_MEMBER_4H, 11
.set CYDEV_CHIP_MEMBER_4I, 17
.set CYDEV_CHIP_MEMBER_4J, 9
.set CYDEV_CHIP_MEMBER_4K, 10
.set CYDEV_CHIP_MEMBER_4L, 16
.set CYDEV_CHIP_MEMBER_4M, 15
.set CYDEV_CHIP_MEMBER_4N, 6
.set CYDEV_CHIP_MEMBER_4O, 5
.set CYDEV_CHIP_MEMBER_4P, 14
.set CYDEV_CHIP_MEMBER_4Q, 7
.set CYDEV_CHIP_MEMBER_4U, 3
.set CYDEV_CHIP_MEMBER_5A, 20
.set CYDEV_CHIP_MEMBER_5B, 19
.set CYDEV_CHIP_MEMBER_FM3, 24
.set CYDEV_CHIP_MEMBER_FM4, 25
.set CYDEV_CHIP_MEMBER_PDL_FM0P_TYPE1, 21
.set CYDEV_CHIP_MEMBER_PDL_FM0P_TYPE2, 22
.set CYDEV_CHIP_MEMBER_PDL_FM0P_TYPE3, 23
.set CYDEV_CHIP_MEMBER_UNKNOWN, 0
.set CYDEV_CHIP_MEMBER_USED, CYDEV_CHIP_MEMBER_5B
.set CYDEV_CHIP_DIE_EXPECT, CYDEV_CHIP_MEMBER_USED
.set CYDEV_CHIP_DIE_ACTUAL, CYDEV_CHIP_DIE_EXPECT
.set CYDEV_CHIP_REV_LEOPARD_ES1, 0
.set CYDEV_CHIP_REV_LEOPARD_ES2, 1
.set CYDEV_CHIP_REV_LEOPARD_ES3, 3
.set CYDEV_CHIP_REV_LEOPARD_PRODUCTION, 3
.set CYDEV_CHIP_REV_PSOC4A_ES0, 17
.set CYDEV_CHIP_REV_PSOC4A_PRODUCTION, 17
.set CYDEV_CHIP_REV_PSOC5LP_ES0, 0
.set CYDEV_CHIP_REV_PSOC5LP_PRODUCTION, 0
.set CYDEV_CHIP_REV_PSOC5TM_ES0, 0
.set CYDEV_CHIP_REV_PSOC5TM_ES1, 1
.set CYDEV_CHIP_REV_PSOC5TM_PRODUCTION, 1
.set CYDEV_CHIP_REV_TMA4_ES, 17
.set CYDEV_CHIP_REV_TMA4_ES2, 33
.set CYDEV_CHIP_REV_TMA4_PRODUCTION, 17
.set CYDEV_CHIP_REVISION_3A_ES1, 0
.set CYDEV_CHIP_REVISION_3A_ES2, 1
.set CYDEV_CHIP_REVISION_3A_ES3, 3
.set CYDEV_CHIP_REVISION_3A_PRODUCTION, 3
.set CYDEV_CHIP_REVISION_4A_ES0, 17
.set CYDEV_CHIP_REVISION_4A_PRODUCTION, 17
.set CYDEV_CHIP_REVISION_4C_PRODUCTION, 0
.set CYDEV_CHIP_REVISION_4D_PRODUCTION, 0
.set CYDEV_CHIP_REVISION_4E_PRODUCTION, 0
.set CYDEV_CHIP_REVISION_4F_PRODUCTION, 0
.set CYDEV_CHIP_REVISION_4F_PRODUCTION_256DMA, 0
.set CYDEV_CHIP_REVISION_4F_PRODUCTION_256K, 0
.set CYDEV_CHIP_REVISION_4G_ES, 17
.set CYDEV_CHIP_REVISION_4G_ES2, 33
.set CYDEV_CHIP_REVISION_4G_PRODUCTION, 17
.set CYDEV_CHIP_REVISION_4H_PRODUCTION, 0
.set CYDEV_CHIP_REVISION_4I_PRODUCTION, 0
.set CYDEV_CHIP_REVISION_4J_PRODUCTION, 0
.set CYDEV_CHIP_REVISION_4K_PRODUCTION, 0
.set CYDEV_CHIP_REVISION_4L_PRODUCTION, 0
.set CYDEV_CHIP_REVISION_4M_PRODUCTION, 0
.set CYDEV_CHIP_REVISION_4N_PRODUCTION, 0
.set CYDEV_CHIP_REVISION_4O_PRODUCTION, 0
.set CYDEV_CHIP_REVISION_4P_PRODUCTION, 0
.set CYDEV_CHIP_REVISION_4Q_PRODUCTION, 0
.set CYDEV_CHIP_REVISION_4U_PRODUCTION, 0
.set CYDEV_CHIP_REVISION_5A_ES0, 0
.set CYDEV_CHIP_REVISION_5A_ES1, 1
.set CYDEV_CHIP_REVISION_5A_PRODUCTION, 1
.set CYDEV_CHIP_REVISION_5B_ES0, 0
.set CYDEV_CHIP_REVISION_5B_PRODUCTION, 0
.set CYDEV_CHIP_REVISION_FM3_PRODUCTION, 0
.set CYDEV_CHIP_REVISION_FM4_PRODUCTION, 0
.set CYDEV_CHIP_REVISION_PDL_FM0P_TYPE1_PRODUCTION, 0
.set CYDEV_CHIP_REVISION_PDL_FM0P_TYPE2_PRODUCTION, 0
.set CYDEV_CHIP_REVISION_PDL_FM0P_TYPE3_PRODUCTION, 0
.set CYDEV_CHIP_REVISION_USED, CYDEV_CHIP_REVISION_5B_PRODUCTION
.set CYDEV_CHIP_REV_EXPECT, CYDEV_CHIP_REVISION_USED
.set CYDEV_CONFIG_FASTBOOT_ENABLED, 1
.set CYDEV_CONFIG_UNUSED_IO_AllowButWarn, 0
.set CYDEV_CONFIG_UNUSED_IO, CYDEV_CONFIG_UNUSED_IO_AllowButWarn
.set CYDEV_CONFIG_UNUSED_IO_AllowWithInfo, 1
.set CYDEV_CONFIG_UNUSED_IO_Disallowed, 2
.set CYDEV_CONFIGURATION_COMPRESSED, 1
.set CYDEV_CONFIGURATION_DMA, 0
.set CYDEV_CONFIGURATION_ECC, 1
.set CYDEV_CONFIGURATION_IMOENABLED, CYDEV_CONFIG_FASTBOOT_ENABLED
.set CYDEV_CONFIGURATION_MODE_COMPRESSED, 0
.set CYDEV_CONFIGURATION_MODE, CYDEV_CONFIGURATION_MODE_COMPRESSED
.set CYDEV_CONFIGURATION_MODE_DMA, 2
.set CYDEV_CONFIGURATION_MODE_UNCOMPRESSED, 1
.set CYDEV_DEBUG_ENABLE_MASK, 0x20
.set CYDEV_DEBUG_ENABLE_REGISTER, CYREG_MLOGIC_DEBUG
.set CYDEV_DEBUGGING_DPS_SWD, 2
.set CYDEV_DEBUGGING_DPS_SWD_SWV, 6
.set CYDEV_DEBUGGING_DPS, CYDEV_DEBUGGING_DPS_SWD_SWV
.set CYDEV_DEBUGGING_ENABLE, 1
.set CYDEV_DEBUGGING_XRES, 0
.set CYDEV_DMA_CHANNELS_AVAILABLE, 24
.set CYDEV_ECC_ENABLE, 0
.set CYDEV_HEAP_SIZE, 0x80
.set CYDEV_INSTRUCT_CACHE_ENABLED, 1
.set CYDEV_INTR_RISING, 0x00000000
.set CYDEV_IS_EXPORTING_CODE, 0
.set CYDEV_IS_IMPORTING_CODE, 0
.set CYDEV_PROJ_TYPE, 2
.set CYDEV_PROJ_TYPE_BOOTLOADER, 1
.set CYDEV_PROJ_TYPE_LAUNCHER, 5
.set CYDEV_PROJ_TYPE_LOADABLE, 2
.set CYDEV_PROJ_TYPE_LOADABLEANDBOOTLOADER, 4
.set CYDEV_PROJ_TYPE_MULTIAPPBOOTLOADER, 3
.set CYDEV_PROJ_TYPE_STANDARD, 0
.set CYDEV_PROTECTION_ENABLE, 0
.set CYDEV_STACK_SIZE, 0x0800
.set CYDEV_USB_CLK_OSC_LOCKING_ENABLED_AT_PWR_UP, 1
.set CYDEV_USE_BUNDLED_CMSIS, 1
.set CYDEV_VARIABLE_VDDA, 0
.set CYDEV_VDDA_MV, 5000
.set CYDEV_VDDD_MV, 5000
.set CYDEV_VDDIO0_MV, 5000
.set CYDEV_VDDIO1_MV, 5000
.set CYDEV_VDDIO2_MV, 5000
.set CYDEV_VDDIO3_MV, 5000
.set CYDEV_VIO0_MV, 5000
.set CYDEV_VIO1_MV, 5000
.set CYDEV_VIO2_MV, 5000
.set CYDEV_VIO3_MV, 5000
.set CYIPBLOCK_ARM_CM3_VERSION, 0
.set CYIPBLOCK_P3_ANAIF_VERSION, 0
.set CYIPBLOCK_P3_CAN_VERSION, 0
.set CYIPBLOCK_P3_CAPSENSE_VERSION, 0
.set CYIPBLOCK_P3_COMP_VERSION, 0
.set CYIPBLOCK_P3_DECIMATOR_VERSION, 0
.set CYIPBLOCK_P3_DFB_VERSION, 0
.set CYIPBLOCK_P3_DMA_VERSION, 0
.set CYIPBLOCK_P3_DRQ_VERSION, 0
.set CYIPBLOCK_P3_DSM_VERSION, 0
.set CYIPBLOCK_P3_EMIF_VERSION, 0
.set CYIPBLOCK_P3_I2C_VERSION, 0
.set CYIPBLOCK_P3_LCD_VERSION, 0
.set CYIPBLOCK_P3_LPF_VERSION, 0
.set CYIPBLOCK_P3_OPAMP_VERSION, 0
.set CYIPBLOCK_P3_PM_VERSION, 0
.set CYIPBLOCK_P3_SCCT_VERSION, 0
.set CYIPBLOCK_P3_TIMER_VERSION, 0
.set CYIPBLOCK_P3_USB_VERSION, 0
.set CYIPBLOCK_P3_VIDAC_VERSION, 0
.set CYIPBLOCK_P3_VREF_VERSION, 0
.set CYIPBLOCK_S8_GPIO_VERSION, 0
.set CYIPBLOCK_S8_IRQ_VERSION, 0
.set CYIPBLOCK_S8_SAR_VERSION, 0
.set CYIPBLOCK_S8_SIO_VERSION, 0
.set CYIPBLOCK_S8_UDB_VERSION, 0
.set DMA_CHANNELS_USED__MASK0, 0x00000000
.set CYDEV_BOOTLOADER_ENABLE, 0
.endif
